## app/module/drivers/sensor/Kconfig
```kconfig
# Copyright (c) 2020 The ZMK Contributors
# SPDX-License-Identifier: MIT

if SENSOR

rsource "battery/Kconfig"
rsource "ec11/Kconfig"
rsource "pmw3389/Kconfig"
rsource "pmw33xx/Kconfig"
rsource "max17048/Kconfig"

endif # SENSOR
```
